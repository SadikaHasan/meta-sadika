## conf/layer.conf
```bitbake
# We have a conf and classes directory, add to BBPATH
BBPATH .= ":${LAYERDIR}"

# We have recipes-* directories, add to BBFILES
BBFILES += "${LAYERDIR}/recipes-*/*/*.bb \
            ${LAYERDIR}/recipes-*/*/*.bbappend"

BBFILE_COLLECTIONS += "meta-sadika"
BBFILE_PATTERN_meta-sadika = "^${LAYERDIR}/"
BBFILE_PRIORITY_meta-sadika = "6"

LAYERDEPENDS_meta-sadika = "core"
LAYERSERIES_COMPAT_meta-sadika = "kirkstone"
```
